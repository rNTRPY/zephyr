## boards/rntrpy/rntrpy_r4vn/Kconfig.rntrpy_r4vn
```kconfig
# SPDX-FileCopyrightText: Copyright The Zephyr Project Contributors
# SPDX-License-Identifier: Apache-2.0

config BOARD_RNTRPY_R4VN
	select SOC_NRF52840_QIAA
```

## boards/rntrpy/rntrpy_r4vn/board.yml
```yaml
board:
  name: rntrpy_r4vn
  full_name: rNTRPY R4VN
  vendor: rntrpy
  socs:
  - name: nrf52840
    variants:
    - name: uf2
```

## dts/bindings/misc/rntrpy,r4vn-board-controls.yaml
```yaml
# Copyright (c) 2026 rNTRPY
# SPDX-License-Identifier: Apache-2.0

description: |
  Miscellaneous board control and status GPIOs of the rNTRPY R4VN board,
  such as the GPS reset line and the charger enable/status pins.

  Each signal is a child node with a single GPIO.

compatible: "rntrpy,r4vn-board-controls"

child-binding:
  description: Board control or status GPIO

  properties:
    gpios:
      type: phandle-array
      required: true

    label:
      type: string
      description: Human readable name of the signal.
```
